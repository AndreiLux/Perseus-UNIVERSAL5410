## drivers/motor/Kconfig
```kconfig
#
#
#
menuconfig VIBETONZ
	tristate "Vibetonz"
	help
	  Say Y to enable Vibetonz support.

config MOTOR_DRV_MAX77803
	tristate "Maxim MAX77803 motor"
	default n
	depends on MFD_MAX77803
	help
	  If you say yes here you will get support for the
	  motor of Maxim MAX77803 PMIC.
```

## drivers/net/wireless/ath/ath9k_btcoex/Kconfig
```kconfig
config ATH9K_BTCOEX_HW
	tristate
config ATH9K_BTCOEX_COMMON
	tristate

config ATH9K_BTCOEX
	tristate "Atheros 802.11n wireless cards support"
	depends on MAC80211
	select ATH9K_BTCOEX_HW
	select MAC80211_LEDS
	select LEDS_CLASS
	select NEW_LEDS
	select ATH9K_BTCOEX_COMMON
	---help---
	  This module adds support for wireless adapters based on
	  Atheros IEEE 802.11n AR5008, AR9001 and AR9002 family
	  of chipsets. For a specific list of supported external
	  cards, laptops that already ship with these cards and
	  APs that come with these cards refer to to ath9k wiki
	  products page:

	  http://wireless.kernel.org/en/users/Drivers/ath9k/products

	  If you choose to build a module, it'll be called ath9k.
```

## drivers/platform/Kconfig
```kconfig
# drivers/platform/Kconfig

if X86
source "drivers/platform/x86/Kconfig"
endif

if ARM
source "drivers/platform/arm/Kconfig"
endif

config CHROMEOS
	bool
	depends on ARM_CHROMEOS_FIRMWARE || (NVRAM && ACPI_CHROMEOS)

	---help---
	  Provides abstracted interfaces to the firmware features provided on
	  ChromeOS devices. It depends on a lowlevel driver to implement the
	  firmware interface on the platform.

config CHROMEOS_RAMOOPS_RAM_START
        hex "Physical address of preserved RAM"
	depends on RAMOOPS && CHROMEOS
        default "0"

        ---help---
          Address of the memory area that is used for logging using ramoops.
	  This value can also be set through platform data.

          For this feature to be useful, the selected memory area must be
          preserved across reboot, so not used by the boot loader, for example.

config CHROMEOS_RAMOOPS_RAM_SIZE
        hex "Size of preserved RAM"
	depends on RAMOOPS && CHROMEOS
        default "0"

        ---help---
          Size of the memory area that is used for logging using ramoops.
	  This value can also be set through platform data.

          For this feature to be useful, the selected memory area must be
          preserved across reboot, so not used by the boot loader, for example.

config CHROMEOS_RAMOOPS_RECORD_SIZE
        hex "Size of a single dump logged in RAM"
	depends on RAMOOPS && CHROMEOS
        default "0x00001000"

        ---help---
          This is the size of a single dump which is logged in RAM. Should be
	  set according to the level of detail needed in the dump.
	  This value can also be set through platform data.

	  Must be divisible by CHROMEOS_RAMOOPS_RAM_SIZE.

config CHROMEOS_RAMOOPS_DUMP_OOPS
        hex "Flag to dump oopses and panics or only panics"
	depends on RAMOOPS && CHROMEOS
        default "1"

        ---help---
	  If flag is set to 0 dump oopses and panics.
	  If flag is set to 1 dump only panics.

	  This value can also be set through platform data.
          For this feature to be useful, the selected memory area must be
          preserved across reboot, so not used by the boot loader, for example.
```

## drivers/sensorhub/Kconfig
```kconfig
#
# sensor drivers configuration
#
config SENSORS_SYSFS
	tristate "Sensors sysfs"
	help
	  Support sysfs for sensors.
          If you say yes here you get sysfs support for
	  sensor factory test.
	  To compile this driver as a module, choose M here: the
	  module will be called sensors_core.

config SENSORS_SSP
	tristate "Sensors ssp"
	default n
	depends on I2C
	help
	  ssp driver for sensor hub.
          If you say yes here you get ssp support for
	  sensor hub.
	  To compile this driver as a module, choose M here: the
	  module will be called ssp.

config SENSORS_SSP_K330
	tristate "Sensors ssp k330"
	default n
	depends on I2C
	help
	  k330 file for factory test in ssp driver.
          If you say yes here you get k330 support for
	  factory test.
	  To compile this driver as a module, choose M here: the
	  module will be called ssp.

config SENSORS_SSP_AK8963C
	tristate "Sensors ssp ak8963c"
	default n
	depends on I2C
	help
	  ak8963c file for factory test in ssp driver.
          If you say yes here you get ak8963c support for
	  factory test.
	  To compile this driver as a module, choose M here: the
	  module will be called ssp.

config SENSORS_SSP_AK8963C_DOEPLUS
	tristate "Sensors ssp ak8963c doe+"
	default n
	depends on I2C
	help
	  ak8963c file for factory test and doeplus in ssp driver.
          If you say yes here you get ak8963c support for
	  factory test.
	  To compile this driver as a module, choose M here: the
	  module will be called ssp.

config SENSORS_SSP_CM36651
	tristate "Sensors ssp cm36651"
	default n
	depends on I2C
	help
	  cm36651 file for factory test in ssp driver.
          If you say yes here you get cm36651 support for
	  factory test.
	  To compile this driver as a module, choose M here: the
	  module will be called ssp.

config SENSORS_SSP_CM3323
	tristate "Sensors ssp cm3323"
	default n
	depends on I2C
	help
	  cm3323 file for factory test in ssp driver.
          If you say yes here you will get cm3323 support for
	  factory test.
	  To compile this driver as a module, choose M here: the
	  module will be called ssp.

config SENSORS_SSP_MAX88920
	tristate "Sensors ssp max88920"
	default n
	depends on I2C
	help
	  max88920 file for factory test in ssp driver.
          If you say yes here you get max88920 support for
	  factory test.
	  To compile this driver as a module, choose M here: the
	  module will be called ssp.

config SENSORS_SSP_BMP182
	tristate "Sensors ssp bmp182"
	default n
	depends on I2C
	help
	  bmp182 file for factory test in ssp driver.
          If you say yes here you get bmp182 support for
	  factory test.
	  To compile this driver as a module, choose M here: the
	  module will be called ssp.

config SENSORS_SSP_SHTC1
	tristate "Sensors ssp shtc1"
	default n
	depends on I2C
	help
	  shtc1 file for factory test in ssp driver.
          If you say yes here you get shtc1 support for
	  factory test.
	  To compile this driver as a module, choose M here: the
	  module will be called ssp.

config SENSORS_SSP_SHTC1_VER
	string "Sensors shtc1 version name"
	default "No_Version_Name"
	depends on SENSORS_SSP_SHTC1
	help
	  shtc1 version for temphumid factory test in ssp driver.
          If you give version name here you get shtc1 version for
	  lcd test.

config SENSORS_SSP_AT32UC3L0128
	tristate "Sensors ssp at32uc3l0128"
	default n
	depends on I2C
	help
	  at32uc3l0128 file for factory test in ssp driver.
          If you say yes here you get at32uc3l0128 support for
	  factory test.
	  To compile this driver as a module, choose M here: the
	  module will be called ssp.

config SENSORS_SSP_ATUC128L5HAR
	tristate "Sensors ssp atuc128l5har"
	default n
	depends on I2C
	help
	  atuc128l5har file for factory test in ssp driver.
          If you say yes here you get atuc128l5har support for
	  factory test.
	  To compile this driver as a module, choose M here: the
	  module will be called ssp.

config SENSORS_SSP_SENSORHUB
	tristate "Sensors ssp sensorhub"
	default n
	depends on I2C
	help
	  ssp sensor hub driver for sensor hub.
          If you say yes here you get ssp support for
	  sensor hub.
	  To compile this driver as a module, choose M here: the
	  module will be called ssp.

config SENSORS_SSP_C12SD
	tristate "Sensors ssp C12SD"
	default n
	depends on SENSORS_SSP
	help
	  This is for GUVA_C12SD UV Sensor
	  device driver.
	  GUVA_C12SD is made by Genicom.
          If you say yes here you get c12sd support.
	  If you say no here c12sd will not be supported.
```

## drivers/sensors/Kconfig
```kconfig
#
# Sensor  drivers configuration
#
menuconfig SENSORS
	bool "Sensor devices"
	help
	  Say Y here, and a list of sensors drivers will be displayed.
	  Everything that didn't fit into the other categories is here. This option
	  doesn't affect the kernel.

	  If unsure, say Y.

config SENSORS_BMI055
	tristate "BMI055 Combo Sensor Driver"
	depends on I2C
	default n
	help
	  If you say yes here you get support for Bosch-Sensortec's
	  BMA254 Acceleration & Gyroscope Sensor.

config SENSORS_AK8963C
	tristate "AK8963C compass support"
	default n
	depends on I2C
	help
	  If you say yes here you get support for Asahi Kasei's
	  orientation sensor AK8963.

config SENSORS_CM3323
	depends on I2C
	tristate "CM3323 driver"
	default n
	help
	  Say Y here if you use cm3323.
	  This option enables RGB sensors using
	  Capella cm3323 device driver.

	  Say N here if you do not use cm3323.

config SENSORS_SX9500
	depends on I2C
	tristate "SX9500 driver"
	default n
	help
	  Say Y here if you use sx9500.
	  This option enables grip sensors using
	  SamTech cm3323 device driver.

	  Say N here if you do not use cm3323.
```

## drivers/staging/omapdce/Kconfig
```kconfig
config DRM_OMAP_DCE
	tristate "OMAP DRM Distributed Codec Engine"
	depends on DRM_OMAP 
	select OMAP_RPMSG
	select OMAP_REMOTEPROC
	default n
	help
	  Plugin for OMAP DRM driver to support hw accellerated video
	  decoders/encoders
```

## drivers/staging/rdaemon/Kconfig
```kconfig
config OMAP_RPMSG_RDAEMON
	tristate "OMAP Rdaemon for rpmsg"
	select OMAP_RPMSG
	select OMAP_REMOTEPROC
	default n
	help
	  Plugin for RPMSG driver on OMAP to test/debug remote processors
```

## drivers/stm/Kconfig
```kconfig
config STM_FW
           tristate "STM Framework Driver Support"
           default n
           help
                     STM Framework Driver

config STM_OMAP_TI1_0
           tristate "STM OMAP TI1.0 Drvier"
           depends on STM_FW
           default n
           help
	 STM OMAP TI1.0 Driver - provides Syet, Trace Macrocell
	 support for V1.0 implementation found in, eg, OMAP4

config STM_ARM
           tristate "STM ARM Driver"
           depends on STM_FW
           default n
           help
	 STM ARM Driver - provides System Trace Macrocell
	 support for ARM V2.0 implementation found in, eg, OMAP5
```

## drivers/video/samsung_extdisp/Kconfig
```kconfig
#
# S3C Video configuration
#

config FB_S5P_EXTDSP
	tristate "S5P External Display Framebuffer support"
	select FB_CFB_FILLRECT
	select FB_CFB_COPYAREA
	select FB_CFB_IMAGEBLIT
	depends on FB && (((ARCH_S5PV210 || ARCH_EXYNOS4) && !FB_S3C) ||ARCH_EXYNOS5)
	default y
	help
	  This enables support for Samsung External Display Controller

config FB_S5P_EXTDSP_DEBUG
	bool "S5P External Display Framebuffer debug messages"
	depends on FB_S5P_EXTDSP
```

## fs/pstore/Kconfig
```kconfig
config PSTORE
	bool "Persistent store support"
	default n
	help
	   This option enables generic access to platform level
	   persistent storage via "pstore" filesystem that can
	   be mounted as /dev/pstore.  Only useful if you have
	   a platform level driver that registers with pstore to
	   provide the data, so you probably should just go say "Y"
	   (or "M") to a platform specific persistent store driver
	   (e.g. ACPI_APEI on X86) which will select this for you.
	   If you don't have a platform persistent store driver,
	   say N.

config PSTORE_CONSOLE
	bool "Log kernel console messages"
	depends on PSTORE
	help
	  When the option is enabled, pstore will log all kernel
	  messages, even if no oops or panic happened.
```

## sound/soc/Kconfig
```kconfig
#
# SoC audio configuration
#

menu "System on Chip audio support"
	depends on SND!=n

config SND_SOC_AC97_BUS
	bool

config SND_SOC
	tristate "Alsa for SoC audio support"
	select SND_PCM
	---help---

	  If you want ASoC support, you should say Y here and also to the
	  specific driver for your SoC platform below.
	  
	  ASoC provides power efficient ALSA support for embedded battery powered
	  SoC based systems like PDA's, Phones and Personal Media Players.

	  This ASoC audio support can also be built as a module.  If so, the module
	  will be called snd-soc-core.

# All the supported Soc's
menu "SoC Platforms"
depends on SND_SOC
source "sound/soc/at91/Kconfig"
source "sound/soc/pxa/Kconfig"
source "sound/soc/s3c24xx/Kconfig"
source "sound/soc/imx/Kconfig"
endmenu

# Supported codecs
source "sound/soc/codecs/Kconfig"

endmenu
```

## sound/soc/au1x/Kconfig
```kconfig
##
## Au1200/Au1550 PSC + DBDMA
##
config SND_SOC_AU1XPSC
	tristate "SoC Audio for Au1200/Au1250/Au1550"
	depends on SND_SOC && (SOC_AU1200 || SOC_AU1550)
	help
	  This option enables support for the Programmable Serial
	  Controllers in AC97 and I2S mode, and the Descriptor-Based DMA
	  Controller (DBDMA) as found on the Au1200/Au1250/Au1550 SoC.

config SND_SOC_AU1XPSC_I2S
	tristate

config SND_SOC_AU1XPSC_AC97
	tristate
	select AC97_BUS
	select SND_AC97_CODEC
	select SND_SOC_AC97_BUS

##
## Boards
##
config SND_SOC_EXM1200_AC97
	tristate "MSC EXM32-Au1200 AC97 support"
	select SND_SOC_AU1XPSC_AC97
	select SND_SOC_AC97_CODEC
	help
	  AC97 sound support for EXM32 Development Motherboard

config SND_SOC_EXM1200_SSI
	tristate "MSC EXM32-Au1200 I2S support"
	depends on I2C!=n
	select SND_SOC_AU1XPSC_I2S
	select SND_SOC_CS4251X
	help
	  I2S sound support for EXM32 Development Motherboard
```

## sound/soc/codecs/Kconfig
```kconfig
config SND_SOC_AC97_CODEC
	tristate
	depends on SND_SOC

config SND_SOC_AK4535
	tristate
	depends on SND_SOC

config SND_SOC_TLV320
	tristate
	depends on SND_SOC

config SND_SOC_UDA1380
	tristate
	depends on SND_SOC

config SND_SOC_WM8510
	tristate
	depends on SND_SOC

config SND_SOC_WM8711
	tristate
	depends on SND_SOC

config SND_SOC_WM8731
	tristate
	depends on SND_SOC

config SND_SOC_WM8750
	tristate
	depends on SND_SOC

config SND_SOC_WM8753
	tristate
	depends on SND_SOC

config SND_SOC_WM8772
	tristate
	depends on SND_SOC
	
config SND_SOC_WM8950
	tristate
	depends on SND_SOC

config SND_SOC_WM8956
	tristate
	depends on SND_SOC

config SND_SOC_WM8960
	tristate
	depends on SND_SOC

config SND_SOC_WM8971
	tristate
	depends on SND_SOC

config SND_SOC_WM8974
	tristate
	depends on SND_SOC

config SND_SOC_WM8976
	tristate
	depends on SND_SOC

config SND_SOC_WM8980
	tristate
	depends on SND_SOC

config SND_SOC_WM9712
	tristate
	depends on SND_SOC

config SND_SOC_WM9713
	tristate
	depends on SND_SOC
```

## sound/soc/imx/Kconfig
```kconfig
config SND_MXC_SOC
	tristate "SoC Audio for the Freescale i.MX CPU"
	depends on ARCH_MXC && SND
	select SND_PCM
	help
	  Say Y or M if you want to add support for codecs attached to
	  the MXC AC97, I2S or SSP interface. You will also need
	  to select the audio interfaces to support below.

config SND_MXC_AC97
	tristate
	select SND_AC97_CODEC

config SND_MXC_SOC_AC97
	tristate
	select AC97_BUS

config SND_MXC_SOC_SSI
	tristate

config SND_SOC_MX31ADS_WM8753
	tristate "SoC Audio support for MX31 - WM8753"
	depends on SND_MXC_SOC && ARCH_MX3
	select SND_MXC_SOC_SSI
	select SND_SOC_WM8753
	help
	  Say Y if you want to add support for SoC audio on MX31ADS
	  with the WM8753.
```
