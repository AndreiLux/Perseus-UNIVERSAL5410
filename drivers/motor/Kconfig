## sound/soc/pxa/Kconfig
```kconfig
config SND_PXA2XX_SOC
	tristate "SoC Audio for the Intel PXA2xx chip"
	depends on ARCH_PXA && SND_SOC
	help
	  Say Y or M if you want to add support for codecs attached to
	  the PXA2xx AC97, I2S or SSP interface. You will also need
	  to select the audio interfaces to support below.

config SND_PXA2XX_AC97
	tristate
	select SND_AC97_CODEC

config SND_PXA2XX_SOC_AC97
	tristate
	select AC97_BUS
	select SND_SOC_AC97_BUS

config SND_PXA2XX_SOC_I2S
	tristate

config SND_PXA2XX_SOC_SSP
	tristate
	select PXA_SSP

config SND_PXA2XX_SOC_CORGI
	tristate "SoC Audio support for Sharp Zaurus SL-C7x0"
	depends on SND_PXA2XX_SOC && PXA_SHARP_C7xx
	select SND_PXA2XX_SOC_I2S
	select SND_SOC_WM8731
	help
	  Say Y if you want to add support for SoC audio on Sharp
	  Zaurus SL-C7x0 models (Corgi, Shepherd, Husky).

config SND_PXA2XX_SOC_SPITZ
	tristate "SoC Audio support for Sharp Zaurus SL-Cxx00"
	depends on SND_PXA2XX_SOC && PXA_SHARP_Cxx00
	select SND_PXA2XX_SOC_I2S
	select SND_SOC_WM8750
	help
	  Say Y if you want to add support for SoC audio on Sharp
	  Zaurus SL-Cxx00 models (Spitz, Borzoi and Akita).

config SND_PXA2XX_SOC_POODLE
	tristate "SoC Audio support for Poodle"
	depends on SND_PXA2XX_SOC && MACH_POODLE
	select SND_PXA2XX_SOC_I2S
	select SND_SOC_WM8731
	help
	  Say Y if you want to add support for SoC audio on Sharp
	  Zaurus SL-5600 model (Poodle).

config SND_PXA2XX_SOC_TOSA
	tristate "SoC AC97 Audio support for Tosa"
	depends on SND_PXA2XX_SOC && MACH_TOSA
	select SND_PXA2XX_SOC_AC97
	select SND_SOC_WM9712
	help
	  Say Y if you want to add support for SoC audio on Sharp
	  Zaurus SL-C6000x models (Tosa).

config SND_PXA2XX_SOC_MAGICIAN
	tristate "SoC Audio support for HTC Magician"
	depends on SND_PXA2XX_SOC
	select SND_PXA2XX_SOC_I2S
	select SND_PXA2XX_SOC_SSP
	select SND_SOC_UDA1380
	help
	  Say Y if you want to add support for SoC audio on the
	  HTC Magician.

config SND_PXA2XX_SOC_AMESOM_TLV320
	tristate "SoC SSP Audio support for AMESOM - TLV320AIC24k"
	depends on SND_PXA2XX_SOC && MACH_AMESOM
	select SND_PXA2XX_SOC_I2S
	select SND_PXA2XX_SOC_SSP
	select SND_SOC_TLV320
	help
	  Say Y if you want to add support for SoC audio on Amesom
	  with the tlv320.
	  
config SND_PXA2XX_SOC_H5000
	tristate "ASoC support for H5000"
	depends on SND_PXA2XX_SOC && MACH_PXA
	select SND_PXA2XX_SOC_I2S
	select SND_SOC_AK4535
	help
	  Say Y if you want to add support for ASoC audio for H5000.

config SND_PXA2XX_SOC_MAINSTONE
	tristate "SoC AC97 Audio support for Intel Mainstone"
	depends on SND_PXA2XX_SOC && MACH_MAINSTONE
	select SND_PXA2XX_AC97
	help
	  Say Y if you want to add support for generic AC97 SoC audio on Mainstone.

config SND_PXA2XX_SOC_MAINSTONE_WM8731
	tristate "SoC I2S Audio support for Intel Mainstone - WM8731"
	depends on SND_PXA2XX_SOC && MACH_MAINSTONE
	select SND_PXA2XX_SOC_I2S
	select SND_SOC_WM8731
	help
	  Say Y if you want to add support for SoC audio on Mainstone
	  with the WM8731.

config SND_PXA2XX_SOC_MAINSTONE_WM8753
	tristate "SoC I2S/SSP Audio support for Intel Mainstone - WM8753"
	depends on SND_PXA2XX_SOC && MACH_MAINSTONE
	select SND_PXA2XX_SOC_I2S
	select SND_PXA2XX_SOC_SSP
	select SND_SOC_WM8753
	help
	  Say Y if you want to add support for SoC audio on Mainstone
	  with the WM8753.

config SND_PXA2XX_SOC_MAINSTONE_WM8974
	tristate "SoC I2S Audio support for Intel Mainstone - WM8974"
	depends on SND_PXA2XX_SOC && MACH_MAINSTONE
	select SND_PXA2XX_SOC_I2S
	select SND_SOC_WM8974
	help
	  Say Y if you want to add support for SoC audio on Mainstone
	  with the WM8974.

config SND_PXA2XX_SOC_MAINSTONE_WM9713
	tristate "SoC I2S/SSP Audio support for Intel Mainstone - WM9713"
	depends on SND_PXA2XX_SOC && MACH_MAINSTONE
	select SND_PXA2XX_SOC_AC97
	select SND_PXA2XX_SOC_SSP
	select SND_SOC_WM9713
	help
	  Say Y if you want to add support for SoC voice audio on Mainstone
	  with the WM9713.

config SND_MAINSTONE_BASEBAND
	tristate "Example SoC Baseband Audio support for Intel Mainstone"
	depends on SND_PXA2XX_SOC && MACH_MAINSTONE
	select SND_PXA2XX_SOC_AC97
	select SND_SOC_WM9713
	help
	  Say Y if you want to add support for SoC baseband on Mainstone
	  with the WM9713 and example Baseband modem.

config SND_MAINSTONE_BLUETOOTH
	tristate "Example SoC Bluetooth Audio support for Intel Mainstone"
	depends on SND_PXA2XX_SOC && MACH_MAINSTONE
	select SND_PXA2XX_SOC_I2S
	select SND_SOC_WM8753
	help
	  Say Y if you want to add support for SoC bluetooth on Mainstone
	  with the WM8753 and example Bluetooth codec.

config SND_PXA2xx_SOC_MAINSTONE_WM9712
	tristate "SoC I2S/SSP Audio support for Intel Mainstone - WM9712"
	depends on SND_PXA2XX_SOC && MACH_MAINSTONE
	select SND_PXA2XX_SOC_AC97
	select SND_SOC_WM9712
	help
	  Say Y if you want to add support for SoC voice audio on Mainstone
	  with the WM9712.
```

## sound/soc/sh/Kconfig
```kconfig
menu "SoC Audio support for SuperH"

config SND_SOC_PCM_SH7760
	tristate "SoC Audio support for Renesas SH7760"
	depends on CPU_SUBTYPE_SH7760 && SND_SOC
	help
	  Enable this option for SH7760 AC97/I2S audio support.



##
## Audio unit modules
##

config SND_SOC_SH4_HAC
	select AC97_BUS
	select SND_SOC_AC97_BUS
	select SND_AC97_CODEC
	tristate

config SND_SOC_SH4_SSI
	tristate



##
## Boards
##

config SND_EXMMB7760_AC97
	tristate "MSC EXM32 Development Motherboard AC97 Audio"
	depends on SND_SOC_PCM_SH7760 && SH_EXM7760
	select SND_SOC_SH4_HAC
	select SND_SOC_AC97_CODEC
	help
	  Select this option if you want AC97 audio on your
	  MSC EXM32-SH7760 Development Motherboard Kit.

config SND_EXMMB7760_SSI
	tristate "MSC EXM32 Development Motherboard I2S Audio"
	depends on SND_SOC_PCM_SH7760 && SH_EXM7760
	select SND_SOC_SH4_SSI
	select SND_SOC_CS4251X
	help
	  Select this option if you want I2S audio on your
	  MSC EXM32-SH7760 Development Motherboard Kit.


endmenu
```

## ubuntu/dm-raid4-5/Kconfig
```kconfig
config DM_RAID45
	tristate "RAID 4/5 target (EXPERIMENTAL)"
	depends on BLK_DEV_DM && EXPERIMENTAL
	default m
	---help---
	A target that supports RAID4 and RAID5 mappings.
```
