/*
 * Copyright (C) 2011 Texas Instruments Incorporated - http://www.ti.com/
 *
 * This program is free software; you can redistribute it and/or modify
 * it under the terms of the GNU General Public License version 2 as
 * published by the Free Software Foundation.
 */
/dts-v1/;

/include/ "skeleton.dtsi"

/ {
	model = "TI OMAP5 uEVM";
	compatible = "ti,omap5-uevm", "ti,omap5432", "ti,omap5";

        chosen {                                                                
                bootargs = "root=/dev/mmcblk1p2 rw rootwait earlyprintk=1 earlycon=ttyO2,115200n8 console=ttyO2,115200n8 loglevel=8";
        };

	chosen_emmc {                                                            
                bootargs = "root=/dev/mmcblk0p2 rw rootwait console=ttyO2,115200n8 loglevel=4";
        };  

	memory {
		device_type = "memory";
		reg = <0x80000000 0x40000000>; /* 1 GB */
	};
};

