## arch/arm/mach-exynos/Kconfig.local
```kconfig
choice
	prompt "Support Target Locale"
	default TARGET_LOCALE_EUR

config TARGET_LOCALE_EUR
	bool "Locale Europe Open support"
	help
	  Enable universal5410 LOCALE EUR.
	  is used to distinguish LOCALE-related difference.
	  Locale Feature is used Revision XX and
	  LTE Only Board.

config TARGET_LOCALE_KOR
	bool "Locale Kor support"
	help
	  Enable universal5410 LOCALE KOR.
	  is used to distinguish LOCALE-related difference.
	  Locale Feature is used Revision XX and
	  LTE Only Board.

config TARGET_LOCALE_JPN
	bool "Locale Japan support"
	help
	  Enable universal5410 LOCALE JPN.

config TARGET_LOCALE_CHN
	bool "Locale China support"
	help
	  Enable universal5410 LOCALE CHN.

endchoice

choice
	prompt "Support KOR Target Carrier"
	depends on MACH_UNIVERSAL5410 && TARGET_LOCALE_KOR
	default MACH_JA_KOR_SKT

config MACH_JA_KOR_SKT
	bool "SKT Operator"
	help
	  Enable Carrier Operator SKT in LOCALE KOR.
	  Exynos5410 is used for AP SoC.
	  Shannon222 is used for CP SoC.
	  is used to distinguish Carrier-related difference.

config MACH_JA_KOR_KT
	bool "KT Operator"
	help
	  Enable Carrier Operator KT in LOCALE KOR.
	  Exynos5410 is used for AP SoC.
	  Shannon222 is used for CP SoC.
	  is used to distinguish Carrier-related difference.

config MACH_JA_KOR_LGT
	bool "LG U+ Operator"
	help
	  Enable Carrier Operator LGU in LOCALE KOR.
	  Exynos5410 is used for AP SoC.
	  MDM9X15 is used for CP SoC.
	  is used to distinguish Carrier-related difference.
endchoice

choice
	prompt "Support KOR Target Board Revision"
	depends on MACH_UNIVERSAL5410 && TARGET_LOCALE_KOR
	default JA_LTE_KOR_REV00

config JA_LTE_KOR_REV00
	bool "JA LTE KOR REV00"
	help
	  Support JA LTE KOR rev0.0.

config JA_LTE_KOR_REV01
	bool "JA LTE KOR REV01"
	help
	  Support JA LTE KOR rev0.1.
endchoice

choice
	prompt "Support JPN Target Carrier"
	depends on MACH_UNIVERSAL5410 && TARGET_LOCALE_JPN
	default MACH_JA_JPN_DCM

config MACH_JA_JPN_DCM
	bool "DCM Operator"
	help
	  Enable Carrier Operator DCM in LOCALE JPN.

endchoice

config SWITCH_DUAL_MODEM
	bool "Switch UART/USB to AP/CP/CP2"
```

## drivers/accessory/Kconfig
```kconfig
#
# Accessory Configuration
#

menuconfig ACCESSORY
	bool "Accessory devices"
	default n
	---help---
	Say Y here to get to see options for Samsung Accessories
	If you say N, all options in this submenu will be skipped and disabled.

if ACCESSORY

config 30PIN_CONN
        tristate "Accessory detection driver"
        depends on I2C
        help
         Provides support for detecting Accessory,such as TA, Keyboard

config SEC_KEYBOARD_DOCK
	tristate "sec keyboard dock support"

endif # ACCESSORY
```

## drivers/battery/Kconfig
```kconfig
config BATTERY_SAMSUNG
	tristate "samsung battery driver"
	help
	 Say Y to include support for samsung battery driver
	 This battery driver integrated all battery-related functions
	 To see battery-related functions,
	 refer to sec_charging_common.h


# Fuel Gauge
	 
config FUELGAUGE_MAX17048
	tristate "MAX17048 fuel gauge driver"
	default n
	depends on BATTERY_SAMSUNG
	help
	 Say Y to include support
	 for MAXIM MAX17048 fuel gauge driver.
	 This fuel-gauge can be used
	 only in voltage-tracking mode.

# Charger

config CHARGER_MAX77803
	tristate "MAX77803 battery charger support"
	depends on MFD_MAX77803 && I2C
	help
	  Say Y here to enable support for the MAX77803 charger
	  MAX77803 incluse muic, pmic, haptic, led,
	  flash driver.
	  You have to define MFD_MAX77693

config SAMSUNG_LPM_MODE
	bool "Off charging mode support in sec battery driver"
	default n
	help
	  Say Y to include support for sec off charging support
	  This value defined at bootloader.
	  Before enable this feature,
	  implemet power off charging in the bootloader.
```

## drivers/cpuidle/Kconfig
```kconfig
config CPU_IDLE
	bool "CPU idle PM support"
	default y if ACPI || PPC_PSERIES
	help
	  CPU idle is a generic framework for supporting software-controlled
	  idle processor power management.  It includes modular cross-platform
	  governors that can be swapped during runtime.

	  If you're using an ACPI-enabled platform, you should say Y here.

config CPU_IDLE_GOV_LADDER
	bool
	depends on CPU_IDLE
	default y

config CPU_IDLE_GOV_MENU
	bool
	depends on CPU_IDLE && NO_HZ
	default y

config ARCH_NEEDS_CPU_IDLE_COUPLED
	def_bool n

config EXYNOS_CPUIDLE_C2
	bool "EXYNOS CPUIDLE C2"
	depends on CPU_IDLE
	default y
	help
	  Enable C2 state on cpuidle
```

## drivers/felica/Kconfig
```kconfig
config FELICA
	bool "FeliCa Driver"
	default n

config NFC_FELICA
	bool "NFCFeliCa Driver"
	default n
```

## drivers/fingerprint/Kconfig
```kconfig
#
# Sensor  drivers configuration
#
menuconfig SENSORS_FINGERPRINT
	bool "Finger Print Sensor devices"
	help
	  Say Y here, and a list of sensors drivers will be displayed.
	  Everything that didn't fit into the other categories is here. This option
	  doesn't affect the kernel.

	  If unsure, say Y.

if SENSORS_FINGERPRINT
config SENSORS_VFS61XX
	tristate "VFS61XX fingerprint sensor support"
	default n
	help
	  If you say yes here you get support for Validity's
	  fingerprint sensor VFS61XX.
endif
```

## drivers/gator/Kconfig
```kconfig
config GATOR
	tristate "Gator module for ARM's Streamline Performance Analyzer"
	default m
	depends on PROFILING
	depends on HIGH_RES_TIMERS
	depends on LOCAL_TIMERS || !(ARM && SMP)
	select TRACING
```

## drivers/gator/driver/Kconfig
```kconfig
config GATOR
	tristate "Gator module for ARM's Streamline Performance Analyzer"
	default m
	depends on GENERIC_TRACER || TRACING
	depends on PROFILING
	depends on HIGH_RES_TIMERS
	depends on LOCAL_TIMERS || !(ARM && SMP)
```

## drivers/gpu/arm/Kconfig
```kconfig
#
# This confidential and proprietary software may be used only as
# authorised by a licensing agreement from ARM Limited
# (C) COPYRIGHT 2012 ARM Limited
# ALL RIGHTS RESERVED
# The entire notice above must be reproduced on all authorised
# copies and copies may only be made to the extent permitted
# by a licensing agreement from ARM Limited.
#

menu "ARM GPU Configuration"
source "drivers/gpu/arm/t6xx/kbase/Kconfig"
endmenu
```

## drivers/gpu/arm/t6xx/kbase/Kconfig
```kconfig
#
# (C) COPYRIGHT 2012 ARM Limited. All rights reserved.
#
# This program is free software and is provided to you under the terms of the GNU General Public License version 2
# as published by the Free Software Foundation, and any use by you of this program is subject to the terms of such GNU licence.
#
# A copy of the licence is included with the program, and can also be obtained from Free Software
# Foundation, Inc., 51 Franklin Street, Fifth Floor, Boston, MA  02110-1301, USA.
#
#


menuconfig MALI_T6XX
	tristate "Mali-T6XX support"
	default n
	help
	  Enable this option to build support for the ARM Mali-T6XX GPU.

	  To compile this driver as a module, choose M here:
	  this will generate a single module, called mali_kbase.

config MALI_GATOR_SUPPORT
	bool "Streamline Debug support"
	depends on MALI_T6XX=m
	default n
	help
	  Adds diagnostic support for use with the ARM Streamline Performance Analyzer.
	  You will need the Gator device driver already loaded before loading this driver when enabling
	  Streamline debug support.

# MALI_EXPERT configuration options

menuconfig MALI_EXPERT
	depends on MALI_T6XX
	bool "Enable Expert Settings"
	default n
	help
	  Enabling this option and modifying the default settings may produce a driver with performance or
	  other limitations.

config MALI_PLATFORM_FAKE
	bool "Enable fake platform device support"
	depends on MALI_T6XX && MALI_EXPERT
	default n
	help
	  When you start to work with the Mali-T600 Series device driver the platform-specific code of
	  the Linux kernel for your platform may not be complete. In this situation the kernel device driver
	  supports creating the platform device outside of the Linux platform-specific code.
	  Enable this option if would like to use a platform device configuration from within the device driver.

choice
	prompt "Platform configuration"
	depends on MALI_T6XX && (MALI_PLATFORM_FAKE && MALI_EXPERT)
	default MALI_PLATFORM_VEXPRESS
	help
	  Select the SOC platform that contains a Mali-T6XX

config MALI_PLATFORM_VEXPRESS
	depends on ARCH_VEXPRESS && (ARCH_VEXPRESS_CA9X4 || ARCH_VEXPRESS_CA15X4)
	bool "Versatile Express"
config MALI_PLATFORM_GOLDFISH
	depends on ARCH_GOLDFISH
	bool "Android Goldfish virtual CPU"
config MALI_PLATFORM_PBX
	depends on ARCH_REALVIEW && REALVIEW_EB_A9MP && MACH_REALVIEW_PBX
	bool "Realview PBX-A9"
config MALI_PLATFORM_THIRDPARTY
	bool "Third Party Platform"
endchoice

config MALI_PLATFORM_THIRDPARTY_NAME
	depends on MALI_T6XX && MALI_PLATFORM_THIRDPARTY && (MALI_PLATFORM_FAKE && MALI_EXPERT)
	string "Third party platform name"
	help
	  Enter the name of a third party platform that is supported. The third part configuration
	  file must be in kbase/src/linux/config/tpip/mali_kbase_config_xxx.c where xxx is the name
	  specifed here.

config MALI_DEBUG
	bool "Debug build"
	depends on MALI_T6XX && MALI_EXPERT
	default n
	help
	  Select this option for increased checking and reporting of errors.

config MALI_UNCACHED
	bool "Disable CPU caching for GPU memory regions"
	depends on MALI_T6XX && MALI_EXPERT
	default n
	help
	  Select this option to disable CPU caching for all GPU memory regions.

config MALI_QA_LEAK
	bool "Enable the tracking of memory leaks"
	depends on MALI_T6XX && MALI_EXPERT
	default n
	help
	  Enables additional memory leak tracking diagnostics.

config MALI_QA_RESFAIL
	bool "Enable simulated failures"
	depends on MALI_T6XX && MALI_EXPERT
	default n
	help
	  Enables forced failures in APIs for additional test coverage

config MALI_NO_MALI
	bool "No Mali"
	depends on MALI_T6XX && MALI_EXPERT
	default n
	help
	  This can be used to test the driver in a simulated environment
	  whereby the hardware is not physically present. If the hardware is physically
	  present it will not be used. This can be used to test the majority of the
	  driver without needing actual hardware or for software benchmarking.
	  All calls to the simulated hardware will complete immediatly as if the hardware
	  completed the task.

config MALI_ERROR_INJECT
	bool "Error injection"
	depends on MALI_T6XX && MALI_EXPERT && MALI_NO_MALI
	default n
	help
	  Enables insertion of errors to test module failure and recovery mechanisms.

config MALI_BASE_ALLOC_FAIL
	bool "Change allocation GFP flags so that allocations can fail"
	depends on MALI_T6XX && MALI_EXPERT
	default n
	help
	  Change the default memory allocation GFP flags so that allocations
	  can fail.

	  By default, kbase memory allocations don't fail. This is consisent
	  with other GPU drivers. However, kbase (i.e. texture memory)
	  allocations are accounted to the process which caused the allocation.
	  This means there's a potential DoS attack an application could make
	  by just allocating lots and lots of memory (E.g. textures). That
	  memory wouldn't be seen as being owned by the malicious/buggy
	  application and so the OOM killer wouldn't kill that app's process.
	  By permitting allocations to fail in low memory situations, we can
	  avoid that DoS attack vector at the cost of GL allocations being able
	  to fail.

	  Turn this on if you're confident your code can handle GL allocations
	  failures.

config T6XX_DVFS
	bool "Enable Dynamic frequency and voltage scaling"
	depends on MALI_T6XX
	default n
	help
	   Choose this option to enable dynamic frequency and voltage scaling

config T6XX_DVFS_FREQ_LOCK
	bool "Enable dvfs frequency lock support"
	depends on T6XX_DVFS
	default n
	help
	  Choose this option to enable locking the DVFS frequency.  If sysfs
	  support is enabled files will be created for inspecting and
	  (potentially) setting a fixed DVFS frequency.  This is used
	  for debugging; enable only if you know what you are doing.

config T6XX_DEBUG_SYS
	bool "Enable sysfs support"
	depends on MALI_T6XX && MALI_EXPERT
	default n
	help
	  Choose this option to enable creating sysfs files for inspecting
	  and (potentially) tweaking driver parameters.  This is typically
	  used for debugging; enable only if you know what you are doing.
```

## drivers/gpu/ion/Kconfig
```kconfig
menuconfig ION
	tristate "Ion Memory Manager"
	select GENERIC_ALLOCATOR
	help
	  Chose this option to enable the ION Memory Manager.

config ION_TEGRA
	tristate "Ion for Tegra"
	depends on ARCH_TEGRA && ION
	help
	  Choose this option if you wish to use ion on an nVidia Tegra.

config ION_EXYNOS
	tristate "Ion for Exynos"
	depends on ARCH_EXYNOS && ION
	select CMA
	help
	  Choose this option if you wish to use ion on a Samsung Exynos.

config ION_EXYNOS_CONTIGHEAP_SIZE
	int "Size in Kilobytes of memory pool of EXYNOS_CONTIG_HEAP"
	depends on ION_EXYNOS && CMA
	default 45056

config ION_EXYNOS_DRM_MFC_SH
	bool "ION Heap for drm mfc sh"
	depends on EXYNOS_CONTENT_PATH_PROTECTION

config ION_EXYNOS_DRM_VIDEO
	bool "ION Heap for drm video"
	depends on EXYNOS_CONTENT_PATH_PROTECTION

config ION_EXYNOS_DRM_MFC_FW
	bool "ION Heap for drm fw"
	depends on EXYNOS_CONTENT_PATH_PROTECTION

config ION_EXYNOS_DRM_SECTBL
	bool "ION Heap for drm sectbl"
	depends on EXYNOS_CONTENT_PATH_PROTECTION

config ION_EXYNOS_DRM_MEMSIZE_FIMD_VIDEO
	int "Reserved memsize in kilobytes for FIMD video"
	depends on ION_EXYNOS_DRM_VIDEO
	default 32768

config ION_EXYNOS_DRM_MEMSIZE_GSC
	int "Reserved memsize in kilobytes for GSC"
	depends on ION_EXYNOS_DRM_VIDEO
	default 33792

config ION_EXYNOS_DRM_MEMSIZE_MFC_SECURE
	int "Reserved memsize in kilobytes for MFC secure"
	depends on ION_EXYNOS_DRM_VIDEO
	default 30720
```

## drivers/gpu/vithar/Kconfig
```kconfig
menuconfig VITHAR
	tristate "Enable Vithar DDK"
	default n
	help
	  Choose this option to enable 3D rendering with vithar DDK.

config VITHAR_HWVER_R0P0
	bool "Vithar HW Version R0P0(EVT1)"
	depends on VITHAR
	default n
	help
	  Choose this option to use EVT1.

config VITHAR_RT_PM
	bool "Enable Runtime power management"
	depends on VITHAR
	default y
	help
	  Choose this option to enable runtime power management on vithar DDK.

config VITHAR_DVFS
	bool "Enable DVFS"
	depends on VITHAR
	default y
	help
	  Choose this option to enable DVFS on vithar DDK.

config VITHAR_ENABLE_DS5
	bool "Enable DS5"
	depends on VITHAR
	default n
	help
	  Choose this option to enable DS5 on vithar DDK.
```

## drivers/media/video/exynos/Kconfig
```kconfig
config VIDEO_EXYNOS
	bool "Exynos Multimedia Devices"
	depends on ARCH_EXYNOS5
	default n
	select VIDEO_FIXED_MINOR_RANGES
	select VIDEOBUF2_DMA_CONTIG
	help
	  This is a representative exynos multimedia device.

if VIDEO_EXYNOS
	source "drivers/media/video/exynos/tv/Kconfig"
endif

config MEDIA_EXYNOS
	bool
	help
	  Compile mdev to use exynos5 media device driver.
```

## drivers/media/video/mhl/Kconfig
```kconfig
#
# mhl drivers configuration
#

menu "Mhl(sii8240) device support"


config SAMSUNG_MHL_8240
        bool "Enable Sii8240 MHL Chip Driver"
        default n
        ---help---
          support Sii9244 MHL Chip Driver

endmenu
```

## drivers/misc/2mic/Kconfig
```kconfig
config 2MIC_AUDIENCE_ES325
	bool "Audience ES325 driver"
	default n
	help
	  This is Audience voice solution devices.
	  The chip version is ES325.
```

## drivers/misc/c2c/Kconfig
```kconfig
#
# C2C XXX
#

menuconfig SAMSUNG_C2C
	tristate "C2C Support (LSI)"
	depends on SOC_EXYNOS_4212 || SOC_EXYNOS5250 || SOC_EXYNOS5410 && CMA
	default n
	help
	  It is for supporting C2C driver.

if SAMSUNG_C2C
config C2C_DEBUG
	bool "C2C Debugging - Print C2C debug messages"
	default y
	help
	  Print C2C debug messages.

config C2C_IPC_ENABLE
	bool "Enable C2C IPC via the Shared Memory"
	default n
	help
	  Enable C2C IPC via the Shared Memory.

config C2C_IPC_ONLY
	bool "Enable C2C only for IPC purpose"
	default n
	help
	  Enable C2C only for IPC purpose.

config C2C_USE_4MB
	bool "Set C2C shared memory to 4MB"
	default n
	help
	  Set C2C shared memory to 4MB.

endif # SAMSUNG_C2C
```
