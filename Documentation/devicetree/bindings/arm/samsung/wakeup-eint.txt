## Documentation/devicetree/bindings/mmc/synposis-dw-mshc.txt
```
* Synopsis Designware Mobile Storage Host Controller

The Synopsis designware mobile storage host controller is used to interface
a SoC with storage medium such as eMMC or SD/MMC cards.

Required Properties:

* compatible: should be one of the following
	- synopsis,dw-mshc: for controllers compliant with synopsis dw-mshc.
	- synopsis,dw-mshc-exynos5250: for controllers with Samsung
	  Exynos5250 specific extentions.

* reg: physical base address of the dw-mshc controller and size of its memory
  region.

* interrupts: interrupt specifier for the controller. The format and value of
  the interrupt specifier depends on the interrupt parent for the controller.

# Slots: The slot specific information are contained within child-nodes with
  each child-node representing a supported slot. There should be atleast one
  child node representing a card slot. The name of the slot child node should
  be 'slot{n}' where n is the unique number of the slot connnected to the
  controller. The following are optional properties which can be included in
  the slot child node.

	* bus-width: specifies the width of the data bus connected from the
	  controller to the card slot. The value should be 1, 4 or 8. In case
	  this property is not specified, a default value of 1 is assumed for
	  this property.

	* cd-gpios: specifies the card detect gpio line. The format of the
	  gpio specifier depends on the gpio controller.

	* wp-gpios: specifies the write protect gpio line. The format of the
	  gpio specifier depends on the gpio controller.

	* gpios: specifies a list of gpios used for command, clock and data
	  bus. The first gpio is the command line and the second gpio is the
	  clock line. The rest of the gpios (depending on the bus-width
	  property) are the data lines in no particular order. The format of
	  the gpio specifier depends on the gpio controller.

Optional properties:

* fifo-depth: The maximum size of the tx/rx fifo's. If this property is not
  specified, the default value of the fifo size is determined from the
  controller registers.

*  card-detect-delay: Delay in milli-seconds before detecting card after card
   insert event. The default value is 0.

* supports-highspeed: Enables support for high speed cards (upto 50MHz)

* card-detection-broken: The card detection functionality is not available on
  any of the slots.

* no-write-protect: The write protect pad of the controller is not connected
  to the write protect pin on the slot.

* keep-power-in-suspend: Preserves card power during a suspend/resume cycle.

* enable-sdio-wakeup: Enables wake up of host system on SDIO IRQ assertion.

Samsung Exynos5250 specific properties:

* samsung,dw-mshc-sdr-timing: Specifies the value of CUI clock divider, CIU
  clock phase shift value in transmit mode and CIU clock phase shift value in
  receive mode for single data rate mode operation. Refer notes of the valid
  values below.

* samsung,dw-mshc-ddr-timing: Specifies the value of CUI clock divider, CIU
  clock phase shift value in transmit mode and CIU clock phase shift value in
  receive mode for double data rate mode operation. Refer notes of the valid
  values below. The order of the cells should be

    - First Cell: 	CIU clock divider value.
    - Second Cell:	CIU clock phase shift value for tx mode.
    - Third Cell:	CIU clock phase shift value for rx mode.

  Valid values for SDR and DDR CIU clock timing:

    - valid values for CIU clock divider, tx phase shift and rx phase shift
      is 0 to 7.

    - When CIU clock divider value is set to 3, all possible 8 phase shift
      values can be used.

    - If CIU clock divider value is 0 (that is divide by 1), both tx and rx
      phase shift clocks should be 0.

Example:

  The MSHC controller node can be split into two portions, SoC specific and
  board specific portions as listed below.

	dwmmc0@12200000 {
		compatible = "synopsis,dw-mshc-exynos5250";
		reg = <0x12200000 0x1000>;
		interrupts = <0 75 0>;
	};

	dwmmc0@12200000 {
		supports-highspeed;
		card-detection-broken;
		no-write-protect;
		fifo-depth = <0x80>;
		card-detect-delay = <200>;
		samsung,dw-mshc-sdr-timing = <2 3 3>;
		samsung,dw-mshc-ddr-timing = <1 2 3>;

		slot0 {
			bus-width = <8>;
			cd-gpios = <&gpc0 2 2 3 3>;
			gpios = <&gpc0 0 2 0 3>, <&gpc0 1 2 0 3>,
				<&gpc1 0 2 3 3>, <&gpc1 1 2 3 3>,
				<&gpc1 2 2 3 3>, <&gpc1 3 2 3 3>,
				<&gpc0 3 2 3 3>, <&gpc0 4 2 3 3>,
				<&gpc0 5 2 3 3>, <&gpc0 6 2 3 3>;
		};
	};
```

## Documentation/devicetree/bindings/power_supply/gpio-charger.txt
```
gpio-charger
~~~~~~~~~~~~

Required properties :
 - compatible : "gpio-charger"
 - gpio : A GPIO to be used by the gpio-charger driver.
   See bindings/gpio/gpio.txt for the GPIO specification format.
 - charger-type : power supply type.
     0 = Unknown
     1 = Battery
     2 = UPS
     3 = Mains
     4 = USB standard downstream port
     5 = USB dedicated charging port
     6 = USB charging downstream port
     7 = USB accessory charger adapter

Example:

	charger {
		compatible = "gpio-charger";
		charger-type = <3>;
		gpio = <&gpf0 2 0 0 0>;
	}
```

## Documentation/devicetree/bindings/sound/daisy-audio-max98095.txt
```
Google Daisy audio complex

Required properties:
- compatible : "google,daisy-audio-max988095"

Optional properties:
- samsung,hp-det-gpios : The GPIO that detects when headphones are plugged in.
- samsung,mic-det-gpios : The GPIO that detects when mic is plugged in.

Example:

sound {
	compatible = "google,daisy-audio-max98095";

	samsung,mic-det-gpios = <&gpx2 0 2 0 0>;
	samsung,hp-det-gpios = <&gpx2 2 2 0 0>;
};
```

## Documentation/devicetree/bindings/sound/max98095.txt
```
MAXIM 98095 audio CODEC

Required properties:

  - compatible : "maxim,max98095"

  - reg : the I2C address of the device.

Optional properties:

  - mic-left-digital :  specifies if the left microphone is a DMIC
			instead of analog
  - mic-right-digital : specifies if the right microphone is a DMIC
			instead of analog

Example:

codec: max98095@11 {
	compatible = "maxim,max98095";
	reg = <0x11>;

	mic-left-digital;
	mic-righ-digital;
};
```

## Documentation/devicetree/bindings/staging/iio/adc/s3c-adc.txt
```
* Samsung's adc controller

Required properties:
  - compatible: value should be any of the following.
      (a) "samsung,s3c24xx-adc", for adc compatible with s3c24xx adc.
      (b) "samsung,s3c2443-adc", for adc compatible with s3c2443 adc.
      (c) "samsung,s3c2416-adc", for adc compatible with s3c2416 adc.
      (d) "samsung,s3c64xx-adc", for adc compatible with s3c64xx adc.
      (e) "samsung,exynos4-adc", for adc compatible exynos4 adc.
      (f) "samsung,exynos5-adc", for adc compatible exynos5 adc.
  - reg: physical base address of the controller and length of memory mapped
    region.
  - interrupts: interrupt number to the cpu.

Example:
	adc@12D10000 {
		compatible = "samsung,exynos5-adc";
		reg = <0x12D10000 0x100>;
		interrupts = <0 106 0>;
		vdd-supply = <&buck5_reg>;
	};
```

## Documentation/devicetree/bindings/usb/exynos-usbphy.txt
```
* Samsung's USB phy built in to some SoCs (like exynos5)

The phy's node in the device tree must be a child of the device tree node for
the USB controller using the phy.

Required properties:
  - compatible: value should be:
      (a) "samsung,exynos-usbphy"

Optional properties:
  - clock-enable-gpio: If present then an external GPIO is used to turn on the
    external clock for the USB phy.  The external clock is needed to get full
    USB 3.0 compliance.  This GPIO is turned off and we move to an internal
    reference clock (which is noisier) when in runtime suspend.
    If this GPIO isn't specified we'll stay with the internal reference clock
    always.

Example (including containing node):
	xhci {
		compatible = "samsung,exynos-xhci";
		reg = <0x12000000 0x10000>;
		interrupts = <0 72 0>;

		samsung,vbus-gpio = <&gpx2 7 1 3 3>;
		phy {
			compatible = "samsung,exynos-usbphy";
			clock-enable-gpio = <&gpy1 1 1 0 3>;
		};
	};
```

## Documentation/devicetree/bindings/video/ps8622.txt
```
ps8622-bridge bindings

Required properties:
	- compatible: "parade,ps8622"
	- reg: first i2c address of the bridge
	- sleep-gpio: OF device-tree gpio specification
	- reset-gpio: OF device-tree gpio specification

Optional property:
	- hpd-gpio: OF device-tree gpio specification of the hotplug pin
		    if it is not connected to the dedicated HPD_DP pin

Example:
	ps8622-bridge@48 {
		compatible = "parade,ps8622";
		reg = <0x48>;
		sleep-gpio = <&gpc3 6 1 0 0>;
		reset-gpio = <&gpc3 1 1 0 0>;
		hpd-gpio = <&gpc3 0 0 0 0>;
	};
```

## Documentation/devicetree/bindings/video/ptn3460.txt
```
ptn3460-bridge bindings

Required properties:
	- compatible: "nxp,ptn3460"
	- reg: i2c address of the bridge
	- powerdown-gpio: OF device-tree gpio specification
	- reset-gpio: OF device-tree gpio specification

Example:
	ptn3460-bridge@20 {
		compatible = "nxp,ptn3460";
		reg = <0x20>;
		powerdown-gpio = <&gpy2 5 1 0 0>;
		reset-gpio = <&gpx1 5 1 0 0>;
	};
```

## arch/arm/configs/android_imx5_defconfig
```kconfig
CONFIG_ARM_PATCH_PHYS_VIRT=y
CONFIG_EXPERIMENTAL=y
CONFIG_SYSVIPC=y
CONFIG_POSIX_MQUEUE=y
CONFIG_BSD_PROCESS_ACCT=y
CONFIG_IKCONFIG=y
CONFIG_IKCONFIG_PROC=y
CONFIG_LOG_BUF_SHIFT=16
CONFIG_BLK_DEV_INITRD=y
# CONFIG_SYSCTL_SYSCALL is not set
CONFIG_ASHMEM=y
CONFIG_EMBEDDED=y
CONFIG_PERF_COUNTERS=y
CONFIG_SLAB=y
CONFIG_PROFILING=y
CONFIG_OPROFILE=y
CONFIG_KPROBES=y
CONFIG_MODULES=y
CONFIG_MODULE_FORCE_LOAD=y
CONFIG_MODULE_UNLOAD=y
CONFIG_MODULE_FORCE_UNLOAD=y
CONFIG_MODVERSIONS=y
CONFIG_MODULE_SRCVERSION_ALL=y
# CONFIG_BLK_DEV_BSG is not set
CONFIG_ARCH_MXC=y
CONFIG_ARCH_MX51=y
CONFIG_MACH_MX51_BABBAGE=y
CONFIG_MACH_MX51_3DS=y
CONFIG_MACH_EUKREA_CPUIMX51=y
CONFIG_MACH_EUKREA_CPUIMX51SD=y
CONFIG_MACH_MX51_EFIKAMX=y
CONFIG_MACH_MX51_EFIKASB=y
CONFIG_MXC_PWM=y
CONFIG_ARM_THUMBEE=y
CONFIG_SWP_EMULATE=y
CONFIG_NO_HZ=y
CONFIG_HIGH_RES_TIMERS=y
CONFIG_AEABI=y
CONFIG_HIGHMEM=y
CONFIG_COMPACTION=y
CONFIG_DEFAULT_MMAP_MIN_ADDR=32768
CONFIG_UACCESS_WITH_MEMCPY=y
CONFIG_CMDLINE="noinitrd console=ttymxc0,115200 root=/dev/nfs nfsroot=192.168.0.101:/shared/nfs ip=dhcp"
CONFIG_KEXEC=y
CONFIG_AUTO_ZRELADDR=y
CONFIG_CPU_FREQ=y
CONFIG_CPU_FREQ_DEFAULT_GOV_INTERACTIVE=y
CONFIG_CPU_FREQ_GOV_PERFORMANCE=y
CONFIG_CPU_FREQ_GOV_POWERSAVE=m
CONFIG_CPU_FREQ_GOV_USERSPACE=m
CONFIG_CPU_FREQ_GOV_ONDEMAND=m
CONFIG_CPU_FREQ_GOV_CONSERVATIVE=m
CONFIG_CPU_FREQ_IMX=y
CONFIG_CPU_IDLE=y
CONFIG_VFP=y
CONFIG_NEON=y
CONFIG_BINFMT_MISC=m
CONFIG_WAKELOCK=y
CONFIG_FB_EARLYSUSPEND=y
CONFIG_PM_RUNTIME=y
CONFIG_PM_DEBUG=y
CONFIG_NET=y
CONFIG_PACKET=y
CONFIG_UNIX=y
CONFIG_XFRM_USER=m
CONFIG_NET_KEY=m
CONFIG_INET=y
CONFIG_IP_MULTICAST=y
CONFIG_IP_PNP=y
CONFIG_IP_PNP_DHCP=y
CONFIG_IP_PNP_BOOTP=y
CONFIG_IP_PNP_RARP=y
# CONFIG_INET_LRO is not set
# CONFIG_IPV6 is not set
CONFIG_NETFILTER=y
CONFIG_CFG80211=y
CONFIG_MAC80211=y
CONFIG_MAC80211_RC_PID=y
CONFIG_MAC80211_RC_DEFAULT_PID=y
CONFIG_UEVENT_HELPER_PATH="/sbin/hotplug"
CONFIG_CONNECTOR=y
CONFIG_MTD=y
CONFIG_MTD_CMDLINE_PARTS=y
CONFIG_MTD_CHAR=y
CONFIG_MTD_BLOCK=y
CONFIG_MTD_OOPS=y
CONFIG_MTD_CFI=y
CONFIG_MTD_CFI_INTELEXT=y
CONFIG_MTD_NAND=y
CONFIG_MTD_ONENAND=y
CONFIG_MTD_ONENAND_VERIFY_WRITE=y
CONFIG_MTD_UBI=y
CONFIG_BLK_DEV_LOOP=y
CONFIG_BLK_DEV_RAM=y
CONFIG_BLK_DEV_RAM_SIZE=65536
CONFIG_SCSI=y
CONFIG_BLK_DEV_SD=y
CONFIG_SCSI_MULTI_LUN=y
CONFIG_SCSI_SCAN_ASYNC=y
CONFIG_MD=y
CONFIG_NETDEVICES=y
CONFIG_MARVELL_PHY=y
CONFIG_DAVICOM_PHY=y
CONFIG_QSEMI_PHY=y
CONFIG_LXT_PHY=y
CONFIG_CICADA_PHY=y
CONFIG_VITESSE_PHY=y
CONFIG_SMSC_PHY=y
CONFIG_BROADCOM_PHY=y
CONFIG_ICPLUS_PHY=y
CONFIG_REALTEK_PHY=y
CONFIG_NATIONAL_PHY=y
CONFIG_STE10XP=y
CONFIG_LSI_ET1011C_PHY=y
CONFIG_MDIO_BITBANG=y
CONFIG_MDIO_GPIO=y
CONFIG_NET_ETHERNET=y
CONFIG_SMC91X=y
# CONFIG_NETDEV_1000 is not set
# CONFIG_NETDEV_10000 is not set
# CONFIG_WLAN is not set
CONFIG_INPUT_FF_MEMLESS=m
CONFIG_INPUT_POLLDEV=y
# CONFIG_INPUT_MOUSEDEV_PSAUX is not set
CONFIG_INPUT_EVDEV=y
CONFIG_INPUT_EVBUG=m
CONFIG_INPUT_KEYRESET=y
CONFIG_KEYBOARD_GPIO=y
CONFIG_KEYBOARD_MPR121=y
CONFIG_MOUSE_PS2=m
CONFIG_MOUSE_PS2_ELANTECH=y
CONFIG_INPUT_TOUCHSCREEN=y
CONFIG_TOUCHSCREEN_SYNAPTICS_I2C_RMI=y
CONFIG_INPUT_MISC=y
CONFIG_INPUT_KEYCHORD=y
CONFIG_INPUT_GPIO=y
CONFIG_SERIO_SERPORT=m
CONFIG_VT_HW_CONSOLE_BINDING=y
# CONFIG_LEGACY_PTYS is not set
# CONFIG_DEVKMEM is not set
CONFIG_SERIAL_IMX=y
CONFIG_SERIAL_IMX_CONSOLE=y
CONFIG_HW_RANDOM=y
CONFIG_DCC_TTY=y
CONFIG_I2C=y
# CONFIG_I2C_COMPAT is not set
CONFIG_I2C_CHARDEV=y
# CONFIG_I2C_HELPER_AUTO is not set
CONFIG_I2C_ALGOBIT=m
CONFIG_I2C_ALGOPCF=m
CONFIG_I2C_ALGOPCA=m
CONFIG_I2C_IMX=y
CONFIG_SPI=y
CONFIG_SPI_IMX=y
CONFIG_GPIO_SYSFS=y
CONFIG_POWER_SUPPLY=y
CONFIG_POWER_SUPPLY_DEBUG=y
CONFIG_TEST_POWER=y
CONFIG_MFD_MC13XXX=y
CONFIG_REGULATOR=y
CONFIG_REGULATOR_FIXED_VOLTAGE=y
CONFIG_REGULATOR_MC13892=y
CONFIG_MEDIA_SUPPORT=y
CONFIG_VIDEO_DEV=y
CONFIG_USB_VIDEO_CLASS=y
CONFIG_FB=y
CONFIG_FB_MODE_HELPERS=y
CONFIG_BACKLIGHT_LCD_SUPPORT=y
CONFIG_LCD_CLASS_DEVICE=y
CONFIG_BACKLIGHT_CLASS_DEVICE=y
# CONFIG_BACKLIGHT_GENERIC is not set
CONFIG_BACKLIGHT_PWM=y
CONFIG_FRAMEBUFFER_CONSOLE=y
CONFIG_FONTS=y
CONFIG_FONT_8x16=y
CONFIG_SOUND=y
CONFIG_SND=y
# CONFIG_SND_DRIVERS is not set
# CONFIG_SND_ARM is not set
# CONFIG_SND_SPI is not set
# CONFIG_SND_USB is not set
CONFIG_SND_SOC=y
CONFIG_SND_IMX_SOC=y
CONFIG_HIDRAW=y
CONFIG_HID_PID=y
CONFIG_USB_HIDDEV=y
CONFIG_USB=y
CONFIG_USB_SUSPEND=y
CONFIG_USB_OTG=y
# CONFIG_USB_OTG_WHITELIST is not set
CONFIG_USB_EHCI_HCD=y
CONFIG_USB_EHCI_MXC=y
CONFIG_USB_STORAGE=y
CONFIG_USB_GADGET=y
CONFIG_USB_ETH=m
CONFIG_USB_FILE_STORAGE=m
CONFIG_MMC=y
CONFIG_MMC_EMBEDDED_SDIO=y
CONFIG_MMC_PARANOID_SD_INIT=y
CONFIG_MMC_BLOCK_DEFERRED_RESUME=y
CONFIG_MMC_SDHCI=y
CONFIG_MMC_SDHCI_PLTFM=y
CONFIG_MMC_SDHCI_ESDHC_IMX=y
CONFIG_NEW_LEDS=y
CONFIG_SWITCH=y
CONFIG_SWITCH_GPIO=y
CONFIG_RTC_CLASS=y
CONFIG_RTC_INTF_DEV_UIE_EMUL=y
CONFIG_DMADEVICES=y
CONFIG_IMX_SDMA=y
CONFIG_STAGING=y
CONFIG_ANDROID=y
CONFIG_ANDROID_BINDER_IPC=y
CONFIG_ANDROID_LOGGER=y
CONFIG_ANDROID_RAM_CONSOLE=y
CONFIG_ANDROID_RAM_CONSOLE_ERROR_CORRECTION=y
CONFIG_ANDROID_TIMED_GPIO=y
CONFIG_ANDROID_LOW_MEMORY_KILLER=y
CONFIG_EXT2_FS=y
CONFIG_EXT3_FS=y
CONFIG_EXT4_FS=y
CONFIG_BTRFS_FS=y
CONFIG_QUOTA=y
CONFIG_QFMT_V2=y
CONFIG_MSDOS_FS=y
CONFIG_VFAT_FS=y
CONFIG_TMPFS=y
CONFIG_ECRYPT_FS=y
CONFIG_JFFS2_FS=y
CONFIG_JFFS2_SUMMARY=y
CONFIG_JFFS2_FS_XATTR=y
CONFIG_JFFS2_COMPRESSION_OPTIONS=y
CONFIG_JFFS2_LZO=y
CONFIG_JFFS2_RUBIN=y
CONFIG_UBIFS_FS=y
CONFIG_CRAMFS=y
CONFIG_PARTITION_ADVANCED=y
CONFIG_NLS_CODEPAGE_437=y
CONFIG_NLS_ISO8859_1=y
CONFIG_PRINTK_TIME=y
CONFIG_MAGIC_SYSRQ=y
CONFIG_SCHEDSTATS=y
CONFIG_TIMER_STATS=y
CONFIG_PROVE_LOCKING=y
# CONFIG_DEBUG_BUGVERBOSE is not set
CONFIG_DEBUG_INFO=y
CONFIG_KEYS=y
CONFIG_SECURITY=y
CONFIG_CRYPTO_MICHAEL_MIC=y
# CONFIG_CRYPTO_ANSI_CPRNG is not set
CONFIG_CRC_CCITT=y
CONFIG_CRC_T10DIF=y
CONFIG_CRC_ITU_T=y
CONFIG_CRC7=y
```
