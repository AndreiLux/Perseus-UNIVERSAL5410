## Documentation/devicetree/bindings/arm/samsung/wakeup-eint.txt
```
* Samsung GPIO Wakeup Interrupt Controller

This document is split into following sections.

[1] Samsung Exynos4 GPIO Wakeup Interrupt Source Controller
[2] Samsung Exynos5 GPIO Wakeup Interrupt Source Controller


[1] Samsung Exynos4 GPIO Wakeup Interrupt Source Controller

Samsung Exynos4 processor supports 32 external wakeup interrupt sources. First
16 of these interrupts are directly connected to GIC and the rest 16 of the
interrupts are grouped together to deliver a single interrupt to GIC.

Required properties:

    - compatible: should be "samsung,exynos4210-wakeup-eint".

    - reg: physical base address of the controller and length of memory
      mapped region.

    - interrupt-controller: Identifies the node as an interrupt controller.

    - interrupt-cells: Specifies the number of cells required to specify the
      interrupt source number. The value of should be <2>. The first cell
      represents the wakeup interrupt source number and the second cell
      should be zero (currently unused).

    - interrupts: List of interrupts generated by the gpio wakeup interrupt
      controller which are connected to a parent interrupt controller. The
      format of the interrupt specifier depends on the interrupt parent
      controller.

Optional properties:

    - interrupt-parent: phandle of the parent interrupt controller, required
      if not inheriting the interrupt parent from the parent node.

Example:

	The following example is from the Exynos4210 dtsi file.

	wakeup_eint: interrupt-controller-wakeup-eint {
		compatible = "samsung,exynos4210-wakeup-eint";
		reg = <0x11000000 0x1000>;
		#interrupt-cells = <2>;
		interrupt-controller;
		interrupts = <0 16 0>, <0 17 0>, <0 18 0>, <0 19 0>,
				<0 20 0>, <0 21 0>, <0 22 0>, <0 23 0>,
				<0 24 0>, <0 25 0>, <0 26 0>, <0 27 0>,
				<0 28 0>, <0 29 0>, <0 30 0>, <0 31 0>,
				<0 32 0>;
	};


[2] Samsung Exynos5 GPIO Wakeup Interrupt Source Controller

Samsung Exynos5 processor supports 32 external wakeup interrupt sources. First
16 of these interrupts are directly connected to GIC and the rest 16 of the
interrupts are grouped together to deliver a single interrupt to interrupt
combiner controller.

Since the wakeup interrupts has two interrupt parents, a interrupt nexus
child node is used that includes a interrupt-map used to translate wakeup
interrupt specifiers into gic and combiner domain interrupts.

Required properties:

    - compatible: should be "samsung,exynos5210-wakeup-eint".

    - reg: physical base address of the controller and length of memory
      mapped region.

    - interrupt-controller: Identifies the node as an interrupt controller.

    - interrupt-cells: Specifies the number of cells required to specify the
      interrupt source number. The value of should be <2>. The first cell
      represents the wakeup interrupt source number and the second cell
      should be zero (currently unused).

    - interrupts: List of interrupts generated by the gpio wakeup interrupt
      controller. Since both gic and combiner controllers are interrupt
      parents, a interrupt nexus child node is used to translate the interrupt
      specifiers into respective gic and combiner interrupt domains (see below).
      The interrupt specifier should be two cells - the first cell should be the
      interrupt number originating from the wakeup controller and the second
      cell should be zero (unused).

    - interrupt-parent: The phandle of the interrupt nexus child node.

    - interrupt-nexus child node: This node is used to translate the interrupt
      specifiers of the wakeup interrupt controller node to the respecitive
      gic or combiner interrupt domain. The interrupt nexus node should include
      the following properties.

      - interrupt-cells: Specifies the number of cells required to specify the
        interrupt source number. The value of should be <2>. The first cell
        represents the wakeup interrupt source number and the second cell
        should be zero (currently unused).

      - #address-cells: value of this property should be zero.

      - #size-cells: value of this property should be zero.

      - interrupt-map: The interrpt-map specifies how interrupt specifiers are
        translated. There should be a interrupt-map entry for each interrupt
        generated by the wakeup interrupt controller. The format of each entry
        in the interrupt map should be

              <#intr 0 parent-phandle parent-interrupt-specifier>

	 where #intr is one of the entries in the 'interrupts' property of the
        parent node.


Example:

	wakeup_eint: interrupt-controller@11400000 {
		compatible = "samsung,exynos5210-wakeup-eint";
		reg = <0x11400000 0x1000>;
		interrupt-controller;
		#interrupt-cells = <2>;
		interrupt-parent = <&eint_nexus>;
		interrupts = <0x0 0>, <0x1 0>, <0x2 0>, <0x3 0>,
			     <0x4 0>, <0x5 0>, <0x6 0>, <0x7 0>,
			     <0x8 0>, <0x9 0>, <0xa 0>, <0xb 0>,
			     <0xc 0>, <0xd 0>, <0xe 0>, <0xf 0>,
			     <0x10 0>;

                wakeup_map: interrupt-map {
                        #interrupt-cells = <2>;
                        #address-cells = <0>;
                        #size-cells = <0>;
                        interrupt-map = <0x0 0 &combiner 23 0>,
                                        <0x1 0 &combiner 24 0>,
                                        <0x2 0 &combiner 25 0>,
                                        <0x3 0 &combiner 25 1>,
                                        <0x4 0 &combiner 26 0>,
                                        <0x5 0 &combiner 26 1>,
                                        <0x6 0 &combiner 27 0>,
                                        <0x7 0 &combiner 27 1>,
                                        <0x8 0 &combiner 28 0>,
                                        <0x9 0 &combiner 28 1>,
                                        <0xa 0 &combiner 29 0>,
                                        <0xb 0 &combiner 29 1>,
                                        <0xc 0 &combiner 30 0>,
                                        <0xd 0 &combiner 30 1>,
                                        <0xe 0 &combiner 31 0>,
                                        <0xf 0 &combiner 31 1>,
                                        <0x10 0 &gic 0 32 0>;
                };
        };
```

## Documentation/devicetree/bindings/gpio/gpio-samsung.txt
```
Samsung Exynos4 GPIO Controller

Required properties:
- compatible: Compatible property value should be "samsung,exynos4-gpio>".

- reg: Physical base address of the controller and length of memory mapped
  region.

- #gpio-cells: Should be 4. The syntax of the gpio specifier used by client nodes
  should be the following with values derived from the SoC user manual.
     <[phandle of the gpio controller node]
      [pin number within the gpio controller]
      [mux function]
      [flags and pull up/down]
      [drive strength]>

  Values for gpio specifier:
  - Pin number: is a value between 0 to 7.
  - Flags and Pull Up/Down: 0 - Pull Up/Down Disabled.
                            1 - Pull Down Enabled.
                            3 - Pull Up Enabled.
          Bit 16 (0x00010000) - Input is active low
  - Drive Strength: 0 - 1x,
                    1 - 3x,
                    2 - 2x,
                    3 - 4x

- gpio-controller: Specifies that the node is a gpio controller.
- #address-cells: should be 1.
- #size-cells: should be 1.
- powerdown-support: This bank supports powerdown configuration registers
- powerdown-settings: Configure GPIO behavior on suspend.
  Array of u32 with ngpio elements.  This properties existence
  indicates the chip supports CONPDN and PUDPDN
     0 - Do not modify - preserve previously set (firmware) value
     1 - Float (input, no PU/PD)
     2 - Pull up (input)
     3 - Pull down (input)
     4 - Output high
     5 - Output low
     6 - Maintain powerup settings

Example:

	gpa0: gpio-controller@11400000 {
		#address-cells = <1>;
		#size-cells = <1>;
		compatible = "samsung,exynos4-gpio";
		reg = <0x11400000 0x20>;
		#gpio-cells = <4>;
		gpio-controller;
		powerdown-support;
		powerdown-settings = <0 0 0 2 0 0>;
	};
```

## Documentation/devicetree/bindings/hdmi/samsung-hdmi.txt
```
* Samsung's HDMI Controller

The Samsung's HDMI controller can drive HDMI and DVI monitors.

Required properties:
- compatible : should be "samsung,exynos5-hdmi"
- reg : base physical address of the controller and length of memory mapped
	region.
- interrupts : interrupt number to the cpu.
- hpd-gpio   : gpio pin number for hpd signals.
```

## Documentation/devicetree/bindings/i2c/samsung-i2c.txt
```
* Samsung's I2C controller

The Samsung's I2C controller is used to interface with I2C devices.

Required properties:
  - compatible: value should be either of the following.
      (a) "samsung, s3c2410-i2c", for i2c compatible with s3c2410 i2c.
      (b) "samsung, s3c2440-i2c", for i2c compatible with s3c2440 i2c.
      (c) "samsung, s3c2440-hdmiphy-i2c", for s3c2440-like i2c used
          inside HDMIPHY block found on several samsung SoCs
  - reg: physical base address of the controller and length of memory mapped
    region.
  - interrupts: interrupt number to the cpu.
  - samsung,i2c-sda-delay: Delay (in ns) applied to data line (SDA) edges.

Optional properties:
  - gpios: The order of the gpios should be the following: <SDA, SCL>.
    The gpio specifier depends on the gpio controller. Required in all
    cases except for "samsung,s3c2440-hdmiphy-i2c" whose input/output
    lines are permanently wired to the respective client
  - samsung,i2c-slave-addr: Slave address in multi-master enviroment. If not
    specified, default value is 0.
  - samsung,i2c-max-bus-freq: Desired frequency in Hz of the bus. If not
    specified, the default value in Hz is 100000.
  - samsung,arbitration-gpios : Two GPIOs to use with the GPIO-based bus
    arbitration protocol (see below). The first should be an output, and is
    used to claim the I2C bus, the second should be an input, and signals that
    the other side wants to claim the bus. This allows two masters to share
    the same I2C bus.

Example:

	i2c@13870000 {
		compatible = "samsung,s3c2440-i2c";
		reg = <0x13870000 0x100>;
		interrupts = <345>;
		samsung,i2c-sda-delay = <100>;
		samsung,i2c-max-bus-freq = <100000>;
		gpios = <&gpd1 2 0 /* SDA */
			 &gpd1 3 0 /* SCL */>;
		#address-cells = <1>;
		#size-cells = <0>;

		wm8994@1a {
			compatible = "wlf,wm8994";
			reg = <0x1a>;
		};

		/* If you want GPIO-based bus arbitration */
		samsung,arbitration-gpios = <&gpf0 3 1 0 0>,	/* AP_CLAIM */
			<&gpe0 4 0 3 0>;			/* EC_CLAIM */
	};


GPIO-based Arbitration
======================
(documented here for want of a better place - an implementation is in the
exynos I2C driver)

This uses GPIO lines between the AP (Exynos) and an attached EC (embedded
controller) which both want to talk on the same I2C bus as master.

The AP and EC each have a 'bus claim' line, which is an output that the
other can see. These are both active low, with pull-ups enabled.

- AP_CLAIM: output from AP, signalling to the EC that the AP wants the bus
- EC_CLAIM: output from EC, signalling to the AP that the EC wants the bus


Algorithm
---------
The basic algorithm is to assert your line when you want the bus, then make
sure that the other side doesn't want it also. A detailed explanation is best
done with an example.

Let's say the AP wants to claim the bus. It:
1. Asserts AP_CLAIM
2. Waits a little bit for the other side to notice (slew time, say 10
microseconds)
3. Checks EC_CLAIM. If this is not asserted, then the AP has the bus, and
we are done
4. Otherwise, wait for a few milliseconds and see if EC_CLAIM is released
5. If not, back off, release the claim and wait for a few more milliseconds
6. Go back to 1 (until retry time has expired)

To release the bus, just de-assert the claim line. If the other wants the bus
it will notice soon enough.

The same algorithm applies on the EC side.
```

## Documentation/devicetree/bindings/mfd/max77686.txt
```
Maxim MAX77686 multi-function device

MAX77686 is a Mulitifunction device with PMIC, RTC and Charger on chip. It is
interfaced to host controller using i2c interface. PMIC and Charger submodules
are addressed using same i2c slave address whereas RTC submodule uses different
i2c slave address,presently for which we are statically creating i2c client
while probing.This document describes the binding for mfd device and PMIC
submodule.

Required properties:
- compatible : Must be "maxim,max77686";
- reg : Specifies the i2c slave address of PMIC block.
- interrupts : This i2c device has an IRQ line connected to the main SoC.
- interrupt-parent : The parent interrupt controller.

Optional node:
- voltage-regulators : The regulators of max77686 have to be instantiated
  under subnode named "voltage-regulators" using the following format.

	regulator_name {
		regulator-compatible = LDOn/BUCKn
		standard regulator constraints....
	};
	refer Documentation/devicetree/bindings/regulator/regulator.txt
- buck_ramp_delay : Ramp delay is the time to settle down after voltage change.
  In some hardware ramp_delay for BUCKs is a configurable parameter.
- reg_op_mode : The regulators of max77686 have various operating mode
  capabilities such as low power mode, standby mode (controlled by PWRREQ
  signal) etc. Check the regulator CTRL register for the bits setting these
  modes.

The regulator-compatible property of regulator should initialized with
string to get matched with their hardware counterparts as follow:

	-LDOn 	:	for LDOs, where n can lie in range 1 to 26.
			example: LDO1, LDO2, LDO26.
	-BUCKn 	:	for BUCKs, where n can lie in range 1 to 9.
			example: BUCK1, BUCK5, BUCK9.

Example:

	max77686@09 {
		compatible = "maxim,max77686";
		interrupt-parent = <&wakeup_eint>;
		interrupts = <26 0>;
		reg = <0x09>;
		max77686,buck_ramp_delay = <1>;

		voltage-regulators {
			ldo11_reg {
				regulator-compatible = "LDO11";
				regulator-name = "vdd_ldo11";
				regulator-min-microvolt = <1900000>;
				regulator-max-microvolt = <1900000>;
				regulator-always-on;
				reg_op_mode = <1>;
			};

			buck1_reg {
				regulator-compatible = "BUCK1";
				regulator-name = "vdd_mif";
				regulator-min-microvolt = <950000>;
				regulator-max-microvolt = <1300000>;
				regulator-always-on;
				regulator-boot-on;
				reg_op_mode = <1>;
			};
	}
```
